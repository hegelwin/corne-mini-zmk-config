#include <behaviors.dtsi>
#include <dt-bindings/zmk/keys.h>
#include <dt-bindings/zmk/kscan_mock.h>

/ {
    behaviors {
        test_caps_word: test_caps_word {
            compatible = "zmk,behavior-extended-caps-word";
            #binding-cells = <0>;
            continue-list = <UNDERSCORE MINUS>;
            word-list = <NUBS KP_MINUS KP_SLASH KP_ENTER KP_DOT>;
        };
    };
};
