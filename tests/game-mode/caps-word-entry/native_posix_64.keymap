#include "../behavior_keymap.dtsi"

&kscan {
    events = <
        /* Activate Caps Word through its actual BASE combo. */
        ZMK_MOCK_PRESS(0,10,10)
        ZMK_MOCK_PRESS(0,19,10)
        ZMK_MOCK_RELEASE(0,10,10)
        ZMK_MOCK_RELEASE(0,19,150)
        ZMK_MOCK_PRESS(0,1,10)
        ZMK_MOCK_RELEASE(0,1,150)

        /* Normal typing layers must still preserve Caps Word. */
        ZMK_MOCK_PRESS(0,31,300)
        ZMK_MOCK_PRESS(0,7,10)
        ZMK_MOCK_RELEASE(0,7,10)
        ZMK_MOCK_RELEASE(0,31,150)
        ZMK_MOCK_PRESS(0,1,10)
        ZMK_MOCK_RELEASE(0,1,150)

        /* GAME entry clears Caps Word without a host-facing terminator key. */
        ZMK_MOCK_PRESS(0,35,10)
        ZMK_MOCK_PRESS(0,9,1100)
        ZMK_MOCK_RELEASE(0,35,10)
        ZMK_MOCK_RELEASE(0,9,150)
        ZMK_MOCK_PRESS(0,11,300)
        ZMK_MOCK_RELEASE(0,11,150)
        ZMK_MOCK_PRESS(0,13,300)
        ZMK_MOCK_RELEASE(0,13,150)

        /* Exit must not restore the old Caps Word state. */
        ZMK_MOCK_PRESS(0,35,10)
        ZMK_MOCK_PRESS(0,9,1100)
        ZMK_MOCK_RELEASE(0,35,10)
        ZMK_MOCK_RELEASE(0,9,150)
        ZMK_MOCK_PRESS(0,1,10)
        ZMK_MOCK_RELEASE(0,1,150)

        /* Caps Word can be deliberately reactivated on BASE. */
        ZMK_MOCK_PRESS(0,10,10)
        ZMK_MOCK_PRESS(0,19,10)
        ZMK_MOCK_RELEASE(0,10,10)
        ZMK_MOCK_RELEASE(0,19,150)
        ZMK_MOCK_PRESS(0,1,10)
        ZMK_MOCK_RELEASE(0,1,150)
    >;
};
