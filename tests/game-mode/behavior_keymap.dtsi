/* Exercise the production keymap, including its actual combo and GAME bindings. */
#include "../../config/corne_choc.keymap"
#include <dt-bindings/zmk/kscan_mock.h>

/ {
    chosen {
        /* The native mock uses a linear scan instead of the hardware layout. */
        /delete-property/ zmk,physical-layout;
    };
};

&kscan {
    rows = <1>;
    columns = <36>;
};
