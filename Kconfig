## boards/arm/corne_choc/Kconfig.board
```kconfig
# Copyright (c) 2020 The ZMK Contributors
# SPDX-License-Identifier: MIT

config BOARD_CORNE_CHOC_LEFT
	bool "Corne Choc Left"
	depends on SOC_NRF52840_QIAA

config BOARD_CORNE_CHOC_RIGHT
    bool "Corne Choc Right"
    depends on SOC_NRF52840_QIAA
```

## dts/bindings/behaviors/zmk,behavior-extended-caps-word.yaml
```yaml
# Copyright (c) 2026
# SPDX-License-Identifier: MIT

description: Extended Caps Word behavior

compatible: "zmk,behavior-extended-caps-word"

include: zero_param.yaml

properties:
  continue-list:
    type: array
    required: true
  word-list:
    type: array
    required: true
  mods:
    type: int
  deactivate-on-layer:
    type: int
    description: Layer whose activation clears Caps Word; omitted to preserve it across layers.
```
